## drivers/Kconfig
```kconfig
# Copyright (c) 2024 Rahul Vagish Arasikere
# SPDX-License-Identifier: Apache-2.0

menu "Device Drivers"

if CLOCK_CONTROL
rsource "clock_control/Kconfig.ti_hercules"
endif

if GPIO
rsource "gpio/Kconfig.ti_hercules"
endif

if HWINFO
rsource "hwinfo/Kconfig.ti_hercules"
endif 

rsource "interrupt_controller/Kconfig.ti_hercules"

if SYS_CLOCK_EXISTS
rsource "timer/Kconfig.ti_hercules"
endif

endmenu
```

## drivers/hwinfo/Kconfig.ti_hercules
```kconfig
# Copyrights (c) 2024 Rahul Arasikere <arasikere.rahul@gmail.com>
# SPDX-License-Identifier: Apache-2.0

config HWINFO_TI_HERCULES
        bool "TI Hercules hwinfo driver"
        default y
        depends on SOC_FAMILY_TI_HERCULES
        select HWINFO_HAS_DRIVER
        help
           Enable RM57Lx hwinfo driver
```

## drivers/interrupt_controller/Kconfig.ti_hercules
```kconfig
# Copyright (C) 2024 Rahul Arasikere <arasikere.rahul@gmail.com>
#
# SPDX-License-Identifier: Apache-2.0

if CPU_CORTEX_R5

config TI_HERCULES_VIM
	bool "TI Vectored Interrupt Manager"
	default y
	depends on DT_HAS_TI_HERCULES_VIM_ENABLED
	help
		The TI Hercules Vectored Interrupt Manager provides hardware assistance for prioritizing
		and aggregating the interrupt sources for ARM Cortex-R5 processor cores.

endif # CPU_CORTEX_R5
```

## drivers/timer/Kconfig.ti_hercules
```kconfig
# Copyrights 2024 Rahul Arasikere <arasikere.rahul@gmail.com>
# SPDX-License-Identifier: Apache-2.0

config TIMER_TI_HERCULES
        bool "TI Hercules RTI driver"
        default y
        depends on SOC_FAMILY_TI_HERCULES
        depends on DT_HAS_TI_HERCULES_RTI_TIMER_ENABLED
	depends on CLOCK_CONTROL && PM
	select TICKLESS_CAPABLE
        select TIMER_HAS_64BIT_CYCLE_COUNTER
        help
           Enable RM57Lx Real Time Interrupt driver to provide SYSTICK source.
```

## dts/bindings/interrupt-controller/ti,hercules-vim.yaml
```yaml
# Copyright (C) 2024 Rahul Arasikere
# SPDX-License-Identifier: Apache-2.0

description: |
  TI Hercules Vectored Interrupt Manager is a external interrupt controller found on
  the Hercules series of safety processors.

compatible: "ti,hercules-vim"

include: [interrupt-controller.yaml, base.yaml]

properties:
  reg:
    required: true

  "#interrupt-cells":
    const: 4

interrupt-cells:
  - type
  - irq
  - priority
  - flags
```

## dts/bindings/timer/ti,hercules-rti-timer.yaml
```yaml
# Copyrights (c) 2025 Rahul Arasikere <arasikere.rahul@gmail.com>
# SPDX-License-Identifier: Apache-2.0

description: |
  TI Hercules Real Time Interrupt (RTI) Driver

  The real-time interrupt (RTI) module provides timer functionality
  for operating systems and for benchmarking code. The RTI module can
  incorporate several counters that define the timebases needed
  for scheduling in the operating system.

compatible: "ti,hercules-rti-timer"

include: [base.yaml]

properties:
  ntu:
    type: string
    description: Network timebase unit selection. Defaults to external1.
    enum:
      - "flexray-macro-tick"
      - "flexray-start-of-cycle"
      - "pll2"
      - "external1"
    default: "external1"

  continue-on-suspend:
    type: boolean
    description: Continue counters on debugging halt.

  increment-on-failure:
    type: boolean
    description: Determines whether the free running counter 0 (RTIFRC0) is automatically incremented if a failing clock on the NTU signal is detected.

  timebase-external:
    type: boolean
    description: |
      Selects whether the free running counter 0 (RTIFRC0) is clocked by the internal up counter 0 (RTIUC0) or from the external signal NTU.
      Setting the TBEXT bit from 0 to 1 will not increment RTIFRC0, since RTIUC0 is reset.
      When the timebase supervisor circuit detects a missing clock edge, then the TBEXT bit is reset.
```
